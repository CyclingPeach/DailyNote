fih_fp: fingerprint {
    compatible = "mediatek, fih_fp";
};

mydemo: demo_test {
    compatible = "ts, hello";
    status = "okay";
    value = /bits/ 8 <88>;
    value 16 = /bits/ 16 <166>;
    value 32 = <251>;
    value32array = <1 2 3 4 5>;
}